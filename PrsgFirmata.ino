/*
 * PrsgFirmata.ino.ino generated by FirmataBuilder
 * Wed Jul 06 2016 16:34:03 GMT-0400 (EDT)
 */

#include <ConfigurableFirmata.h>

#include <AnalogInputFirmata.h>
AnalogInputFirmata analogInput;

#include <DigitalOutputFirmata.h>
DigitalOutputFirmata digitalOutput;

#include <Wire.h>
#include <I2CFirmata.h>
I2CFirmata i2c;

#include <FirmataExt.h>
FirmataExt firmataExt;

#include <FirmataReporting.h>
FirmataReporting reporting;

#include "FirmataEncoder.h"
FirmataEncoder encoder;

void systemResetCallback()
{
  for (byte i = 0; i < TOTAL_PINS; i++) {
    if (IS_PIN_ANALOG(i)) {
      // turns off pull-up, configures everything
      Firmata.setPinMode(i, ANALOG);
    } else if (IS_PIN_DIGITAL(i)) {
      // sets the output to 0, configures portConfigInputs
      Firmata.setPinMode(i, OUTPUT);
    }
  }
  firmataExt.reset();
}

void setup()
{
  Firmata.setFirmwareVersion(FIRMWARE_MAJOR_VERSION, FIRMWARE_MINOR_VERSION);

  firmataExt.addFeature(analogInput);
  firmataExt.addFeature(digitalOutput);
  firmataExt.addFeature(i2c);
  firmataExt.addFeature(reporting);
  firmataExt.addFeature(encoder);

  Firmata.attach(SYSTEM_RESET, systemResetCallback);

  Serial1.begin(57600);
  Firmata.begin(Serial1);
  while (!Serial1) {
    // do nothing
  }

  systemResetCallback();
}

void loop()
{
  while(Firmata.available()) {
    Firmata.processInput();
  }

  if (reporting.elapsed()) {
    analogInput.report();
    i2c.report();
    encoder.report();
  }
}
